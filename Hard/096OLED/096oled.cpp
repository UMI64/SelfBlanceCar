#include "096oled.h"
const unsigned char F6x8[][6] =
{
	0x00, 0x00, 0x00, 0x00, 0x00, 0x00,// sp
	0x00, 0x00, 0x00, 0x2f, 0x00, 0x00,// !
	0x00, 0x00, 0x07, 0x00, 0x07, 0x00,// "
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	0x14, 0x14, 0x14, 0x14, 0x14, 0x14,// horiz lines
};
const unsigned char StartUPcmd[] =
{
	0xAE,//display off
    0x20,//Set Memory Addressing Mode 
    0x10,//00,Horizontal Addressing Mode;01,Vertical Addressing Mode;10,Page Addressing Mode (RESET);11,Invalid
    0xb0,//Set Page Start Address for Page Addressing Mode,0-7
    0xc8,//Set COM Output Scan Direction
    0x00,//---set low column address
    0x10,//---set high column address
    0x40,//--set start line address
    0x81,//--set contrast control register
    0xff,//亮度调节 0x00~0xff
    0xa1,//--set segment re-map 0 to 127
    0xa6,//--set normal display
    0xa8,//--set multiplex ratio(1 to 64)
    0x3F,//
    0xa4,//0xa4,Output follows RAM content;0xa5,Output ignores RAM content
    0xd3,//-set display offset
    0x00,//-not offset
    0xd5,//--set display clock divide ratio/oscillator frequency
    0xf0,//--set divide ratio
    0xd9,//--set pre-charge period
    0x22,//
    0xda,//--set com pins hardware configuration
    0x12,
    0xdb,//--set vcomh
    0x20,//0x20,0.77xVcc
    0x8d,//--set DC-DC enable
    0x14,//
    0xaf//--turn on oled panel
};
void OLED096::delay_ms(uint16_t ms)
{
	uint16_t i=0;  
   while(ms--)
   {
      i=12000;  //自己定义
      while(i--) ;    
   }
}
 /**
  * @brief  OLED_ON，将OLED从休眠中唤醒
  * @param  无
    * @retval 无
  */
void OLED096::OLED_ON()
{
    I2CPort.Device_WriteN8bit(1,OLED_ADDR,0x00,0X8D);//设置电荷泵
    I2CPort.Device_WriteN8bit(1,OLED_ADDR,0x00,0X14);//开启电荷泵
    I2CPort.Device_WriteN8bit(1,OLED_ADDR,0x00,0XAF);//OLED唤醒
}
void OLED096::OLED_OFF()
{
	I2CPort.Device_WriteN8bit(1,OLED_ADDR,0x00,0xAE);//display off
    I2CPort.Device_WriteN8bit(1,OLED_ADDR,0x00,0xAE);//display off
}
 /**
  * @brief  OLED_SetPos，设置光标
  * @param  x,光标x位置
    *                   y，光标y位置
  * @retval 无
  */
void OLED096::OLED_SetPos(uint8_t x,uint8_t y) //设置起始点坐标
{
    I2CPort.Device_WriteN8bit(1,OLED_ADDR,0x00,0xb0+y);
    I2CPort.Device_WriteN8bit(1,OLED_ADDR,0x00,((x&0xf0)>>4)|0x10);
    //I2CPort.Device_WriteN8bit(1,OLED_ADDR,0x00,(x&0x0f)|0x01);//给我偷偷加一
	I2CPort.Device_WriteN8bit(1,OLED_ADDR,0x00,x&0x0f);
}
void OLED096::OLED_Set8Byte(uint8_t Data)
{
	I2CPort.Device_WriteN8bit(1,OLED_ADDR,0x40,Data);
}
void OLED096::OLED_Fill(uint8_t * fill_Data)//全屏填充
{
	unsigned char m,n;
    for(m=0;m<8;m++)
    {
        I2CPort.Device_WriteN8bit(1,OLED_ADDR,0x00,0xb0+m);       //page0-page1
        I2CPort.Device_WriteN8bit(1,OLED_ADDR,0x00,(u8)0x00);     //low column start address
        I2CPort.Device_WriteN8bit(1,OLED_ADDR,0x00,0x10);     //high column start address
        for(n=0;n<128;n++)
		{
			I2CPort.Device_WriteN8bit(1,OLED_ADDR,0x40,*fill_Data);
			fill_Data++;
		}
    }
}
 /**
  * @brief  OLED_Fill，填充整个屏幕
  * @param  fill_Data:要填充的数据
    * @retval 无
  */
void OLED096::OLED_Fill(uint8_t fill_Data)//全屏填充
{
    unsigned char m,n;
    for(m=0;m<8;m++)
    {
        I2CPort.Device_WriteN8bit(1,OLED_ADDR,0x00,0xb0+m);       //page0-page1
        I2CPort.Device_WriteN8bit(1,OLED_ADDR,0x00,(u8)0x00);     //low column start address
        I2CPort.Device_WriteN8bit(1,OLED_ADDR,0x00,0x10);     //high column start address
        for(n=0;n<128;n++)
		{
			I2CPort.Device_WriteN8bit(1,OLED_ADDR,0x40,fill_Data);
		}
    }
}

void OLED096::OLED_CLS()//清屏
{
    OLED_Fill((uint8_t)0x00);
}

/**
  * @brief  OLED_ShowStr，显示codetab.h中的ASCII字符,有6*8和8*16可选择
  * @param  x,y : 起始点坐标(x:0~127, y:0~7);
    *                   ch[] :- 要显示的字符串; 
    *                   TextSize : 字符大小(1:6*8 ; 2:8*16)
    * @retval 无
  */
void OLED096::OLED_ShowStr(unsigned char x, unsigned char y,const char * ch)
{
    unsigned char c = 0,i = 0,j = 0;
	while(ch[j] != '\0')
	{
		c = ch[j] - 32;
		if(x > 126)
		{
			x = 0;
			y++;
		}
		OLED_SetPos(x,y);
		for(i=0;i<6;i++)
			I2CPort.Device_WriteN8bit(1,OLED_ADDR,0x40,F6x8[c][i]);
		x += 6;
		j++;
	}
}
void OLED096::OLED_Init()
{
    delay_ms(100); //这里的延时很重要
	uint8_t Lenth=sizeof(StartUPcmd)/sizeof(StartUPcmd[0]);
	for (uint8_t time=0;time<Lenth;time++)
	{
		I2CPort.Device_WriteN8bit(1,OLED_ADDR,0x00,StartUPcmd[time]);
	}	
	OLED_CLS();
}
